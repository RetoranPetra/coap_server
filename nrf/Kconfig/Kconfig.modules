## nrf/Kconfig/Kconfig.modules
```kconfig
menu "nrf (/home/retoran/embeddedSys/nordicSC/nrf)"
osource "/home/retoran/embeddedSys/nordicSC/nrf/Kconfig.nrf"
config ZEPHYR_NRF_MODULE
	bool
	default y
endmenu
menu "hostap (/home/retoran/embeddedSys/nordicSC/modules/lib/hostap)"
osource "/home/retoran/embeddedSys/nordicSC/modules/lib/hostap/zephyr/Kconfig"
config ZEPHYR_HOSTAP_MODULE
	bool
	default y
endmenu
menu "mcuboot (/home/retoran/embeddedSys/nordicSC/bootloader/mcuboot)"
osource "$(ZEPHYR_MCUBOOT_KCONFIG)"
config ZEPHYR_MCUBOOT_MODULE
	bool
	default y
endmenu
menu "mbedtls (/home/retoran/embeddedSys/nordicSC/modules/crypto/mbedtls)"
osource "$(ZEPHYR_MBEDTLS_KCONFIG)"
config ZEPHYR_MBEDTLS_MODULE
	bool
	default y
endmenu
menu "trusted-firmware-m (/home/retoran/embeddedSys/nordicSC/modules/tee/tf-m/trusted-firmware-m)"
osource "$(ZEPHYR_TRUSTED_FIRMWARE_M_KCONFIG)"
config ZEPHYR_TRUSTED_FIRMWARE_M_MODULE
	bool
	default y
endmenu
menu "cjson (/home/retoran/embeddedSys/nordicSC/modules/lib/cjson)"
osource "$(ZEPHYR_CJSON_KCONFIG)"
config ZEPHYR_CJSON_MODULE
	bool
	default y
endmenu
menu "azure-sdk-for-c (/home/retoran/embeddedSys/nordicSC/modules/lib/azure-sdk-for-c)"
osource "$(ZEPHYR_AZURE_SDK_FOR_C_KCONFIG)"
config ZEPHYR_AZURE_SDK_FOR_C_MODULE
	bool
	default y
endmenu
menu "memfault-firmware-sdk (/home/retoran/embeddedSys/nordicSC/modules/lib/memfault-firmware-sdk)"
osource "/home/retoran/embeddedSys/nordicSC/modules/lib/memfault-firmware-sdk/ports/zephyr/Kconfig"
config ZEPHYR_MEMFAULT_FIRMWARE_SDK_MODULE
	bool
	default y
endmenu
menu "cirrus-logic (/home/retoran/embeddedSys/nordicSC/modules/hal/cirrus-logic)"
osource "/home/retoran/embeddedSys/nordicSC/modules/hal/cirrus-logic/Kconfig"
config ZEPHYR_CIRRUS_LOGIC_MODULE
	bool
	default y
endmenu
menu "openthread (/home/retoran/embeddedSys/nordicSC/modules/lib/openthread)"
osource "$(ZEPHYR_OPENTHREAD_KCONFIG)"
config ZEPHYR_OPENTHREAD_MODULE
	bool
	default y
endmenu
menu "canopennode (/home/retoran/embeddedSys/nordicSC/modules/lib/canopennode)"
osource "$(ZEPHYR_CANOPENNODE_KCONFIG)"
config ZEPHYR_CANOPENNODE_MODULE
	bool
	default y
endmenu
menu "chre (/home/retoran/embeddedSys/nordicSC/modules/lib/chre)"
osource "/home/retoran/embeddedSys/nordicSC/modules/lib/chre/platform/zephyr/Kconfig"
config ZEPHYR_CHRE_MODULE
	bool
	default y
endmenu
menu "fatfs (/home/retoran/embeddedSys/nordicSC/modules/fs/fatfs)"
osource "$(ZEPHYR_FATFS_KCONFIG)"
config ZEPHYR_FATFS_MODULE
	bool
	default y
endmenu
menu "hal_nordic (/home/retoran/embeddedSys/nordicSC/modules/hal/nordic)"
osource "$(ZEPHYR_HAL_NORDIC_KCONFIG)"
config ZEPHYR_HAL_NORDIC_MODULE
	bool
	default y
endmenu
menu "liblc3 (/home/retoran/embeddedSys/nordicSC/modules/lib/liblc3)"
osource "$(ZEPHYR_LIBLC3_KCONFIG)"
config ZEPHYR_LIBLC3_MODULE
	bool
	default y
endmenu
menu "littlefs (/home/retoran/embeddedSys/nordicSC/modules/fs/littlefs)"
osource "$(ZEPHYR_LITTLEFS_KCONFIG)"
config ZEPHYR_LITTLEFS_MODULE
	bool
	default y
endmenu
menu "loramac-node (/home/retoran/embeddedSys/nordicSC/modules/lib/loramac-node)"
osource "$(ZEPHYR_LORAMAC_NODE_KCONFIG)"
config ZEPHYR_LORAMAC_NODE_MODULE
	bool
	default y
endmenu
menu "lvgl (/home/retoran/embeddedSys/nordicSC/modules/lib/gui/lvgl)"
osource "/home/retoran/embeddedSys/nordicSC/modules/lib/gui/lvgl/zephyr/Kconfig"
config ZEPHYR_LVGL_MODULE
	bool
	default y
endmenu
menu "lz4 (/home/retoran/embeddedSys/nordicSC/modules/lib/lz4)"
osource "$(ZEPHYR_LZ4_KCONFIG)"
config ZEPHYR_LZ4_MODULE
	bool
	default y
endmenu
menu "nanopb (/home/retoran/embeddedSys/nordicSC/modules/lib/nanopb)"
osource "$(ZEPHYR_NANOPB_KCONFIG)"
config ZEPHYR_NANOPB_MODULE
	bool
	default y
endmenu
menu "picolibc (/home/retoran/embeddedSys/nordicSC/modules/lib/picolibc)"
osource "/home/retoran/embeddedSys/nordicSC/modules/lib/picolibc/zephyr/Kconfig"
config ZEPHYR_PICOLIBC_MODULE
	bool
	default y
endmenu
menu "TraceRecorder (/home/retoran/embeddedSys/nordicSC/modules/debug/TraceRecorder)"
osource "/home/retoran/embeddedSys/nordicSC/modules/debug/TraceRecorder/kernelports/Zephyr/Kconfig"
config ZEPHYR_TRACERECORDER_MODULE
	bool
	default y
endmenu
menu "uoscore-uedhoc (/home/retoran/embeddedSys/nordicSC/modules/lib/uoscore-uedhoc)"
osource "$(ZEPHYR_UOSCORE_UEDHOC_KCONFIG)"
config ZEPHYR_UOSCORE_UEDHOC_MODULE
	bool
	default y
endmenu
menu "zcbor (/home/retoran/embeddedSys/nordicSC/modules/lib/zcbor)"
osource "$(ZEPHYR_ZCBOR_KCONFIG)"
config ZEPHYR_ZCBOR_MODULE
	bool
	default y
endmenu
menu "zscilib (/home/retoran/embeddedSys/nordicSC/modules/lib/zscilib)"
osource "/home/retoran/embeddedSys/nordicSC/modules/lib/zscilib/Kconfig.zscilib"
config ZEPHYR_ZSCILIB_MODULE
	bool
	default y
endmenu
menu "nrfxlib (/home/retoran/embeddedSys/nordicSC/nrfxlib)"
osource "/home/retoran/embeddedSys/nordicSC/nrfxlib/Kconfig.nrfxlib"
config ZEPHYR_NRFXLIB_MODULE
	bool
	default y
endmenu
menu "connectedhomeip (/home/retoran/embeddedSys/nordicSC/modules/lib/matter)"
osource "/home/retoran/embeddedSys/nordicSC/modules/lib/matter/config/nrfconnect/chip-module/Kconfig"
config ZEPHYR_CONNECTEDHOMEIP_MODULE
	bool
	default y
endmenu
```
